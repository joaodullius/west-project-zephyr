## west.yml
```yaml
# Example application-specific west.yml, using manifest imports.
manifest:
  remotes:
    - name: zephyrproject-rtos
      url-base: https://github.com/zephyrproject-rtos
  projects:
    - name: zephyr
      repo-path: zephyr
      remote: zephyrproject-rtos
      revision: v3.1.0
      import: true
    - name: zephyr-course
      path: samples
      revision: main
      url: https://github.com/joaodullius/zephyr-course.git
  self:
    # Where this repository should be cloned to
    path: my_repo
```
